## config/west.yml
```yaml
manifest:
  remotes:
    - name: zmkfirmware
      url-base: https://github.com
  projects:
    - name: zmk
      remote: zmkfirmware
      revision: v0.5.0
      import: app/west.yml
  self:
    path: config
```
